## drivers/staging/misysinfofreader/Kconfig
```kconfig
config MISYSINFOFREADER
	bool "enable miui sys info fast reader"
	depends on MMU
	default n
	help
	  This module is created by MIUI to read sys info from kernel fastly.
```
